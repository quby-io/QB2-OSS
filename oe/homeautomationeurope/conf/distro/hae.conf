## oe/homeautomationeurope/conf/distro/hae.conf
```bitbake
#@--------------------------------------------------------------------
#@TYPE: Distribution
#@NAME: HAE
#@DESCRIPTION: HAE
#@MAINTAINER: HAE
#@--------------------------------------------------------------------

DISTRO_NAME = "HAE"
DISTRO_VERSION = "${DATE}"
DISTRO_REVISION = "2"
DISTRO_TYPE = "release"

# Branding
TARGET_VENDOR = "-hae"

#TARGET_OS ?= "linux"
#TARGET_OS = "linux-uclibc"


# We want images supporting the following features (for task-base)
#ALL: DISTRO_FEATURES = "largefile ipv4 ipv6 nfs smbfs wifi ppp alsa bluetooth ext2 vfat irda pcmcia usbgadget usbhost pci pam" 
DISTRO_FEATURES = " eabi ipv4 ipv6 wifi alsa ext2 vfat usbgadget usbhost"
DISTRO_FEATURES += " uboot redboot "
# NOTE: keep MACHINE_FEATURES + DISTRO_FEATURES in sync!


MACHINE_TASK_PROVIDER = "dropbear"

# Generate locales on the buildsystem instead of on the target. Speeds up first boot, set to "1" to enable
ENABLE_BINARY_LOCALE_GENERATION ?= "1"
GLIBC_GENERATE_LOCALES = "en_US.UTF-8 en_GB.UTF-8 nl_NL.UTF-8 de_DE.UTF-8 fr_FR.UTF-8 es_ES.UTF-8 it_IT.UTF-8" 
LOCALE_UTF8_ONLY = "1"
USE_NLS = "yes"


#make devshell available as task
INHERIT += "devshell"

#############################################################################
# packaging syste: ipkg / opkg
#############################################################################

# If we're using an .ipk based rootfs, we want to have opkg installed so postinst script can run
PREFERRED_PKG_FORMAT = "ipk"
IPKG_VARIANT = "opkg"
INHERIT += "package_ipk"
# Build ipk's wrapped with tar.gz instead of ar, like OpenWRT has them
IPKGBUILDCMD = "ipkg-build -c -o 0 -g 0"
#possible options: none, add, full
ONLINE_PACKAGE_MANAGEMENT = "full"
#PREFERRED_PROVIDER_virtual/update-alternatives ?= "opkg"
PREFERRED_PROVIDER_virtual/update-alternatives-native ?= "opkg-native"
PREFERRED_PROVIDER_virtual/update-alternatives ?= ${PREFERRED_PROVIDER_opkg}

# in bitbake.conf: PACKAGES = "${PN}-dbg ${PN} ${PN}-doc ${PN}-dev ${PN}-locale"
# we don't want -dbg -doc -dev -locale packages!
# need -dev for some packages to install in staging dir!
#PACKAGES = "${PN} ${PN}-dev"

# for sysvinit-inittab, amongst others:
MACHINE_ARCH	:= "${PACKAGE_ARCH}"


#############################################################################


# grr, ${SRCREV} woes....
SRCREV_pn-opkg ?= "HEAD"
SRCREV_pn-opkg-nogpg ?= "HEAD"
SRCREV_pn-opkg-native ?= "HEAD"
#SRCREV_pn-opkg ?= "4346"
#SRCREV_pn-opkg-native ?= "4346"
#
SRCREV_pn-calibrateproto ?= "1da6fd1e2c7a49648245c98481fabea8b9690a8c"
SRCREV_pn-calibrateproto ?= "HEAD"
SRCREV_pn-libxcalibrate ?= "HEAD"

PREFERRED_PROVIDER_virtual/db = "db"
PREFERRED_PROVIDER_virtual/db-native = "db-native"
PREFERRED_PROVIDER_virtual/libqte2 = "qte-mt"

PREFERRED_PROVIDER_xdmcp = "libxdmcp"
PREFERRED_PROVIDER_xfont = "libxfont"



# This is what lives in SDK
#ASSUME_PROVIDED += "virtual/${TARGET_PREFIX}gcc virtual/libc"

# Rename packages to names used in OpenWRT
#PKG_ncurses = "libncurses"




# fix for libgpg-error $CC
#export CC_FOR_BUILD = "gcc"


#TERMCMD = "screen -r 'OE/${PACKAGE_ARCH}/d'"

#SCREEN_TERMCMD = 'screen -m -t "OE/${PACKAGE_ARCH}/d"'
#SCREEN_TERMCMDRUN = '${SCREEN_TERMCMD} $SHELLCMDS'

BASH_TERMCMD = 'bash --login'
BASH_TERMCMDRUN = '${BASH_TERMCMD} -c $SHELLCMDS'

TERMCMD = "${SCREEN_TERMCMD}"
TERMCMDRUN = "${SCREEN_TERMCMDRUN}"
```

## oe/homeautomationeurope/conf/machine/quby2.conf
```bitbake
#@TYPE: Machine
#@Name: ProDrive Quby2
#@DESCRIPTION: Machine configuration for Quby2

#
# Hardware-based properties
#
TARGET_ARCH = "arm"
TARGET_FPU = "soft"
TARGET_OS  = "linux-gnueabi"

FEED_ARCH = "qb2"
PACKAGE_ARCH = "qb2"
BASE_PACKAGE_ARCH = "qb2"

# when (${MACHINE} != ${PACKAGE_ARCH}), add it to PACKAGE_ARCHS:
PACKAGE_ARCHS += "${PACKAGE_ARCH}"

ROOT_FLASH_SIZE = "128"
VOLATILE_STORAGE_SIZE = "64"
MACHINE_GUI_CLASS = "smallscreen"
MACHINE_DISPLAY_WIDTH_PIXELS = "800"
MACHINE_DISPLAY_HEIGHT_PIXELS = "480"

#OLD: MACHINE_FEATURES = "kernel26 apm touchscreen screen alsa usbgadget usbhost serial sound rgb32 ethernet ipv4 ipv6"
MACHINE_FEATURES = "kernel26 apm touchscreen screen sound alsa usbgadget usbhost serial i2c spi ethernet ipv4 ipv6 wifi"
MACHINE_FEATURES += " uboot " 
# NOTE: keep MACHINE_FEATURES + DISTRO_FEATURES in sync!

#
# Software/packages selection
#
PREFERRED_PROVIDER_virtual/kernel		= "linux-quby2"
#PREFERRED_PROVIDER_virtual/kernel		= "linux"
#PREFERRED_VERSION_virtual/kernel		= "2.6.36"

# next is now handles by sane-toolchain.inc:
#
#PREFERRED_PROVIDER_virtual/libc			= "glibc"
#PREFERRED_PROVIDER_libc					= "glibc"
#PREFERRED_PROVIDER_glibc				= "glibc"
#PREFERRED_PROVIDER_virtual/libiconv		= "glibc"
#PREFERRED_PROVIDER_virtual/libintl		= "glibc"
#
#
##NOTE: multiple providers are available for virtual/arm-linux-gnueabi-libc-for-gcc (glibc, external-toolchain-csl, external-toolchain-generic, eglibc, external-toolchain);
##PREFERRED_PROVIDER_virtual/${TARGET_PREFIX}libc-for-gcc	= "glibc-intermediate" OLD-ONE
#PREFERRED_PROVIDER_virtual/${TARGET_PREFIX}libc-for-gcc	= "glibc"
#
##NOTE: multiple providers are available for virtual/arm-linux-gnueabi-libc-initial (glibc-initial, external-toolchain-csl, eglibc-initial, external-toolchain-generic);
#PREFERRED_PROVIDER_virtual/${TARGET_PREFIX}libc-initial	= "glibc-initial"
#
##NOTE: multiple providers are available for virtual/arm-linux-gnueabi-binutils
#PREFERRED_PROVIDER_virtual/${TARGET_PREFIX}binutils		= "binutils-cross"
#
##This is unrelated to the kernel version, but userspace apps (e.g. HAL) require a recent version to build against
#PREFERRED_VERSION_linux-libc-headers					= "2.6.36"
##PREFERRED_PROVIDER_linux-libc-headers					= "linux-quby2"
##NOTE: multiple providers are available for linux-libc-headers (linux-libc-headers, external-toolchain-csl, external-toolchain-generic, external-toolchain);
#PREFERRED_PROVIDER_linux-libc-headers					= "linux-libc-headers"
#

#############################################################################
# stuff from distro we put here for flexibility
#############################################################################
# Base line versions, good for most things (from sane-toolchain.inc)
PREFERRED_GCC_VERSION					= "4.5"
#PREFERRED_GCC_VERSION					= "4.4.2"
PREFERRED_BINUTILS_VERSION				= "2.21"
#PREFERRED_BINUTILS_VERSION				= "2.19.51"
PREFERRED_EGLIBC_VERSION				= "2.12"
PREFERRED_GLIBC_VERSION					= "2.10.1"
PREFERRED_VERSION_linux-libc-headers	= "2.6.34"
LIBC = "glibc"
require conf/distro/include/sane-toolchain.inc


## <from tune-arm926ejs.inc>
TARGET_CC_ARCH = "-march=armv5te -mtune=arm926ej-s"
TARGET_LDFLAGS = ""

ARM_INSTRUCTION_SET = "arm"
require conf/distro/include/arm-thumb.inc

#MY_VERSION_GLIBC = "2.10.1"
#PREFERRED_VERSION_glibc 			?= "${MY_VERSION_GLIBC}"
#PREFERRED_VERSION_glibc-initial 	?= "${MY_VERSION_GLIBC}"
#
#MY_BINUTILS_VERSION = "2.19.51"
#PREFERRED_VERSION_binutils               ?= "${MY_BINUTILS_VERSION}"
#REFERRED_VERSION_binutils-cross         ?= "${MY_BINUTILS_VERSION}"
#PPREFERRED_VERSION_binutils-cross-sdk     ?= "${MY_BINUTILS_VERSION}"
#
#MY_GCC_VERSION = "4.4.2"
#PREFERRED_VERSION_gcc                    ?= "${MY_GCC_VERSION}"
#PREFERRED_VERSION_gcc-cross              ?= "${MY_GCC_VERSION}"
#PREFERRED_VERSION_gcc-cross-sdk          ?= "${MY_GCC_VERSION}"
#PREFERRED_VERSION_gcc-cross-initial      ?= "${MY_GCC_VERSION}"
#PREFERRED_VERSION_gcc-cross-intermediate ?= "${MY_GCC_VERSION}"

#############################################################################

# until we have flash-for-directfb-1.4
PREFERRED_VERSION_directfb 				= "1.2.8"

#XSERVER = "xserver-kdrive-fbdev"
#PREFERRED_PROVIDER_virtual/xserver		= "xserver-kdrive-fbdev"
#PREFERRED_PROVIDER_virtual/libx11		= "diet-x11"
#PREFERRED_PROVIDER_virtual/libsdl   	= "libsdl-directfb"

#############################################################################

SRCREV_pn-opkg = "635"
SRCREV_pn-opkg-native = "633"

#############################################################################

# used by sysvinit_2
SERIAL_CONSOLE = "115200 ttymxc0"
#USE_VT = "1"



# From dmesg:
# UBI: smallest flash I/O unit:    2048
# UBI: logical eraseblock size:    129024 bytes
# UBIFS: file system size:   123088896 bytes (120204 KiB, 117 MiB, 954 LEBs)
MKUBIFS_ARGS = "-m 2048 -e 129024 -c 954"

# from dmesg:
# UBI: smallest flash I/O unit:    2048
# UBI: physical eraseblock size:   131072 bytes (128 KiB)
# UBI: sub-page size:              512
UBINIZE_ARGS = "-m 2048 -p 128KiB -s 512"
UBI_VOLNAME = "rootfs"
```
